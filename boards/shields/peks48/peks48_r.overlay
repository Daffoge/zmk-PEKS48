#include "peks48.dtsi"
#include <input/processors.dtsi>

&default_transform {
    col-offset = <6>;
};

&xiao_serial { status = "disabled"; };

/ {
    aliases {
        "led-red" = &led0;
        "led-blue" = &led1;
        "led-green" = &led2;
    };
};
